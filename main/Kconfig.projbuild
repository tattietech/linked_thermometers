## main/Kconfig.projbuild
```kconfig
menu "Wi-Fi Configuration"

    config WIFI_SSID
        string "Wi-Fi SSID"
        default "MYWiFi"


    config WIFI_PASSWORD
        string "Wi-Fi PAssword"
        default "MYPassword"

endmenu
menu "Server Configuration"
config API_KEY
    string "API Key"
    default ""
config API_ENDPOINT
        string "API ENDPOINT"
        default ""

endmenu
```
